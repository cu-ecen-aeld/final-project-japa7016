## meta-inkcal/conf/layer.conf
```bitbake
# We have a conf and classes directory, add to BBPATH
BBPATH .= ":${LAYERDIR}"

# We have recipes-* directories, add to BBFILES
BBFILES += "${LAYERDIR}/recipes-*/*/*.bb \
            ${LAYERDIR}/recipes-*/*/*.bbappend"

BBFILE_COLLECTIONS += "meta-inkcal"
BBFILE_PATTERN_meta-inkcal = "^${LAYERDIR}/"
BBFILE_PRIORITY_meta-inkcal = "6"

LAYERDEPENDS_meta-inkcal = "core"
LAYERSERIES_COMPAT_meta-inkcal = "hardknott kirkstone"
```
